## sim/build_sim/Kconfig/soc/Kconfig.sysbuild
```kconfig
# Load SoC sysbuild Kconfig descriptions.
osource "/home/davit/Desktop/sim/zephyr/soc/xlnx/zynqmp/Kconfig.sysbuild"
osource "/home/davit/Desktop/sim/zephyr/soc/xlnx/zynq7000/Kconfig.sysbuild"
osource "/home/davit/Desktop/sim/zephyr/soc/xen/Kconfig.sysbuild"
osource "/home/davit/Desktop/sim/zephyr/soc/wch/ch32v/Kconfig.sysbuild"
osource "/home/davit/Desktop/sim/zephyr/soc/ti/simplelink/Kconfig.sysbuild"
osource "/home/davit/Desktop/sim/zephyr/soc/ti/lm3s6965/Kconfig.sysbuild"
osource "/home/davit/Desktop/sim/zephyr/soc/ti/k3/Kconfig.sysbuild"
osource "/home/davit/Desktop/sim/zephyr/soc/telink/tlsr/Kconfig.sysbuild"
osource "/home/davit/Desktop/sim/zephyr/soc/starfive/jh71xx/Kconfig.sysbuild"
osource "/home/davit/Desktop/sim/zephyr/soc/st/stm32/Kconfig.sysbuild"
osource "/home/davit/Desktop/sim/zephyr/soc/snps/qemu_arc/Kconfig.sysbuild"
osource "/home/davit/Desktop/sim/zephyr/soc/snps/nsim/arc_v/Kconfig.sysbuild"
osource "/home/davit/Desktop/sim/zephyr/soc/snps/nsim/arc_classic/Kconfig.sysbuild"
osource "/home/davit/Desktop/sim/zephyr/soc/snps/hsdk4xd/Kconfig.sysbuild"
osource "/home/davit/Desktop/sim/zephyr/soc/snps/hsdk/Kconfig.sysbuild"
osource "/home/davit/Desktop/sim/zephyr/soc/snps/emsk/Kconfig.sysbuild"
osource "/home/davit/Desktop/sim/zephyr/soc/snps/emsdp/Kconfig.sysbuild"
osource "/home/davit/Desktop/sim/zephyr/soc/snps/arc_iot/Kconfig.sysbuild"
osource "/home/davit/Desktop/sim/zephyr/soc/silabs/Kconfig.sysbuild"
osource "/home/davit/Desktop/sim/zephyr/soc/sifive/sifive_freedom/Kconfig.sysbuild"
osource "/home/davit/Desktop/sim/zephyr/soc/rockchip/Kconfig.sysbuild"
osource "/home/davit/Desktop/sim/zephyr/soc/renode/riscv_virtual/Kconfig.sysbuild"
osource "/home/davit/Desktop/sim/zephyr/soc/renesas/smartbond/Kconfig.sysbuild"
osource "/home/davit/Desktop/sim/zephyr/soc/renesas/rzt2m/Kconfig.sysbuild"
osource "/home/davit/Desktop/sim/zephyr/soc/renesas/rcar/Kconfig.sysbuild"
osource "/home/davit/Desktop/sim/zephyr/soc/renesas/ra/Kconfig.sysbuild"
osource "/home/davit/Desktop/sim/zephyr/soc/raspberrypi/Kconfig.sysbuild"
osource "/home/davit/Desktop/sim/zephyr/soc/quicklogic/eos_s3/Kconfig.sysbuild"
osource "/home/davit/Desktop/sim/zephyr/soc/qemu/virt_riscv/Kconfig.sysbuild"
osource "/home/davit/Desktop/sim/zephyr/soc/qemu/malta/Kconfig.sysbuild"
osource "/home/davit/Desktop/sim/zephyr/soc/openisa/rv32m1/Kconfig.sysbuild"
osource "/home/davit/Desktop/sim/zephyr/soc/nxp/s32/Kconfig.sysbuild"
osource "/home/davit/Desktop/sim/zephyr/soc/nxp/rw/Kconfig.sysbuild"
osource "/home/davit/Desktop/sim/zephyr/soc/nxp/mcx/Kconfig.sysbuild"
osource "/home/davit/Desktop/sim/zephyr/soc/nxp/lpc/Kconfig.sysbuild"
osource "/home/davit/Desktop/sim/zephyr/soc/nxp/layerscape/Kconfig.sysbuild"
osource "/home/davit/Desktop/sim/zephyr/soc/nxp/kinetis/Kconfig.sysbuild"
osource "/home/davit/Desktop/sim/zephyr/soc/nxp/imxrt/Kconfig.sysbuild"
osource "/home/davit/Desktop/sim/zephyr/soc/nxp/imx/Kconfig.sysbuild"
osource "/home/davit/Desktop/sim/zephyr/soc/nuvoton/numicro/Kconfig.sysbuild"
osource "/home/davit/Desktop/sim/zephyr/soc/nuvoton/numaker/Kconfig.sysbuild"
osource "/home/davit/Desktop/sim/zephyr/soc/nuvoton/npcx/Kconfig.sysbuild"
osource "/home/davit/Desktop/sim/zephyr/soc/nuvoton/npcm/Kconfig.sysbuild"
osource "/home/davit/Desktop/sim/zephyr/soc/nordic/Kconfig.sysbuild"
osource "/home/davit/Desktop/sim/zephyr/soc/neorv32/Kconfig.sysbuild"
osource "/home/davit/Desktop/sim/zephyr/soc/native/inf_clock/Kconfig.sysbuild"
osource "/home/davit/Desktop/sim/zephyr/soc/microchip/miv/Kconfig.sysbuild"
osource "/home/davit/Desktop/sim/zephyr/soc/microchip/mec/Kconfig.sysbuild"
osource "/home/davit/Desktop/sim/zephyr/soc/mediatek/mtk_adsp/Kconfig.sysbuild"
osource "/home/davit/Desktop/sim/zephyr/soc/lowrisc/opentitan/Kconfig.sysbuild"
osource "/home/davit/Desktop/sim/zephyr/soc/litex/litex_vexriscv/Kconfig.sysbuild"
osource "/home/davit/Desktop/sim/zephyr/soc/ite/ec/Kconfig.sysbuild"
osource "/home/davit/Desktop/sim/zephyr/soc/intel/raptor_lake/Kconfig.sysbuild"
osource "/home/davit/Desktop/sim/zephyr/soc/intel/lakemont/Kconfig.sysbuild"
osource "/home/davit/Desktop/sim/zephyr/soc/intel/intel_socfpga_std/Kconfig.sysbuild"
osource "/home/davit/Desktop/sim/zephyr/soc/intel/intel_socfpga/Kconfig.sysbuild"
osource "/home/davit/Desktop/sim/zephyr/soc/intel/intel_niosv/Kconfig.sysbuild"
osource "/home/davit/Desktop/sim/zephyr/soc/intel/intel_ish/Kconfig.sysbuild"
osource "/home/davit/Desktop/sim/zephyr/soc/intel/intel_adsp/Kconfig.sysbuild"
osource "/home/davit/Desktop/sim/zephyr/soc/intel/elkhart_lake/Kconfig.sysbuild"
osource "/home/davit/Desktop/sim/zephyr/soc/intel/atom/Kconfig.sysbuild"
osource "/home/davit/Desktop/sim/zephyr/soc/intel/apollo_lake/Kconfig.sysbuild"
osource "/home/davit/Desktop/sim/zephyr/soc/intel/alder_lake/Kconfig.sysbuild"
osource "/home/davit/Desktop/sim/zephyr/soc/infineon/cat3/Kconfig.sysbuild"
osource "/home/davit/Desktop/sim/zephyr/soc/infineon/cat1b/Kconfig.sysbuild"
osource "/home/davit/Desktop/sim/zephyr/soc/infineon/cat1a/Kconfig.sysbuild"
osource "/home/davit/Desktop/sim/zephyr/soc/gd/gd32/Kconfig.sysbuild"
osource "/home/davit/Desktop/sim/zephyr/soc/gaisler/leon3/Kconfig.sysbuild"
osource "/home/davit/Desktop/sim/zephyr/soc/gaisler/gr716a/Kconfig.sysbuild"
osource "/home/davit/Desktop/sim/zephyr/soc/espressif/Kconfig.sysbuild"
osource "/home/davit/Desktop/sim/zephyr/soc/ene/kb1200/Kconfig.sysbuild"
osource "/home/davit/Desktop/sim/zephyr/soc/efinix/sapphire/Kconfig.sysbuild"
osource "/home/davit/Desktop/sim/zephyr/soc/cdns/xtensa_sample_controller/Kconfig.sysbuild"
osource "/home/davit/Desktop/sim/zephyr/soc/cdns/dc233c/Kconfig.sysbuild"
osource "/home/davit/Desktop/sim/zephyr/soc/brcm/bcmvk/Kconfig.sysbuild"
osource "/home/davit/Desktop/sim/zephyr/soc/brcm/bcm2712/Kconfig.sysbuild"
osource "/home/davit/Desktop/sim/zephyr/soc/brcm/bcm2711/Kconfig.sysbuild"
osource "/home/davit/Desktop/sim/zephyr/soc/atmel/sam0/Kconfig.sysbuild"
osource "/home/davit/Desktop/sim/zephyr/soc/atmel/sam/Kconfig.sysbuild"
osource "/home/davit/Desktop/sim/zephyr/soc/aspeed/Kconfig.sysbuild"
osource "/home/davit/Desktop/sim/zephyr/soc/arm/Kconfig.sysbuild"
osource "/home/davit/Desktop/sim/zephyr/soc/arm/beetle/Kconfig.sysbuild"
osource "/home/davit/Desktop/sim/zephyr/soc/andestech/Kconfig.sysbuild"
osource "/home/davit/Desktop/sim/zephyr/soc/ambiq/Kconfig.sysbuild"
osource "/home/davit/Desktop/sim/zephyr/soc/altr/zephyr_nios2f/Kconfig.sysbuild"
osource "/home/davit/Desktop/sim/zephyr/soc/altr/qemu_nios2/Kconfig.sysbuild"
osource "/home/davit/Desktop/sim/zephyr/soc/adi/max32/Kconfig.sysbuild"
```
