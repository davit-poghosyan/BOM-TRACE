## sim/build_sim/Kconfig/Kconfig.modules
```kconfig
config ZEPHYR_SIM_FW_MODULE
   bool
   default y
menu "vcp (/home/davit/Desktop/sim/wch-test/modules/vcp)"
osource "/home/davit/Desktop/sim/wch-test/modules/vcp/Kconfig"
config ZEPHYR_VCP_MODULE
	bool
	default y
endmenu
menu "queue-chan (/home/davit/Desktop/sim/wch-test/modules/queue-chan)"
osource "/home/davit/Desktop/sim/wch-test/modules/queue-chan/Kconfig"
config ZEPHYR_QUEUE_CHAN_MODULE
	bool
	default y
endmenu
menu "scope (/home/davit/Desktop/sim/wch-test/modules/scope)"
osource "/home/davit/Desktop/sim/wch-test/modules/scope/Kconfig"
config ZEPHYR_SCOPE_MODULE
	bool
	default y
endmenu
menu "cmsis (/home/davit/Desktop/sim/modules/hal/cmsis)"
osource "$(ZEPHYR_CMSIS_KCONFIG)"
config ZEPHYR_CMSIS_MODULE
	bool
	default y
endmenu
menu "hal_wch (/home/davit/Desktop/sim/modules/hal/wch)"
osource "/home/davit/Desktop/sim/modules/hal/wch/Kconfig.wch"
config ZEPHYR_HAL_WCH_MODULE
	bool
	default y
endmenu
menu "littlefs (/home/davit/Desktop/sim/modules/fs/littlefs)"
osource "$(ZEPHYR_LITTLEFS_KCONFIG)"
config ZEPHYR_LITTLEFS_MODULE
	bool
	default y
endmenu
menu "mbedtls (/home/davit/Desktop/sim/modules/crypto/mbedtls)"
osource "$(ZEPHYR_MBEDTLS_KCONFIG)"
config ZEPHYR_MBEDTLS_MODULE
	bool
	default y
endmenu
config ZEPHYR_MCUBOOT_MODULE
   bool
   default y
```

## sim/build_sim/Kconfig/Kconfig.sysbuild.modules
```kconfig
config ZEPHYR_SIM_FW_MODULE
   bool
   default y
config ZEPHYR_VCP_MODULE
   bool
   default y
config ZEPHYR_QUEUE_CHAN_MODULE
   bool
   default y
config ZEPHYR_SCOPE_MODULE
   bool
   default y
config ZEPHYR_CMSIS_MODULE
   bool
   default y
config ZEPHYR_HAL_WCH_MODULE
   bool
   default y
config ZEPHYR_LITTLEFS_MODULE
   bool
   default y
config ZEPHYR_MBEDTLS_MODULE
   bool
   default y
config ZEPHYR_MCUBOOT_MODULE
   bool
   default y
```

## sim/build_sim/Kconfig/arch/Kconfig
```kconfig
# Load arch Kconfig descriptions.
osource "/home/davit/Desktop/sim/zephyr/arch/x86/Kconfig"
osource "/home/davit/Desktop/sim/zephyr/arch/xtensa/Kconfig"
osource "/home/davit/Desktop/sim/zephyr/arch/sparc/Kconfig"
osource "/home/davit/Desktop/sim/zephyr/arch/riscv/Kconfig"
osource "/home/davit/Desktop/sim/zephyr/arch/posix/Kconfig"
osource "/home/davit/Desktop/sim/zephyr/arch/nios2/Kconfig"
osource "/home/davit/Desktop/sim/zephyr/arch/mips/Kconfig"
osource "/home/davit/Desktop/sim/zephyr/arch/arm64/Kconfig"
osource "/home/davit/Desktop/sim/zephyr/arch/arm/Kconfig"
osource "/home/davit/Desktop/sim/zephyr/arch/arc/Kconfig"
```

## sim/build_sim/Kconfig/soc/Kconfig
```kconfig
# Load Zephyr SoC Kconfig descriptions.
osource "/home/davit/Desktop/sim/zephyr/soc/xlnx/zynqmp/Kconfig"
osource "/home/davit/Desktop/sim/zephyr/soc/xlnx/zynq7000/Kconfig"
osource "/home/davit/Desktop/sim/zephyr/soc/xen/Kconfig"
osource "/home/davit/Desktop/sim/zephyr/soc/wch/ch32v/Kconfig"
osource "/home/davit/Desktop/sim/zephyr/soc/ti/simplelink/Kconfig"
osource "/home/davit/Desktop/sim/zephyr/soc/ti/lm3s6965/Kconfig"
osource "/home/davit/Desktop/sim/zephyr/soc/ti/k3/Kconfig"
osource "/home/davit/Desktop/sim/zephyr/soc/telink/tlsr/Kconfig"
osource "/home/davit/Desktop/sim/zephyr/soc/starfive/jh71xx/Kconfig"
osource "/home/davit/Desktop/sim/zephyr/soc/st/stm32/Kconfig"
osource "/home/davit/Desktop/sim/zephyr/soc/snps/qemu_arc/Kconfig"
osource "/home/davit/Desktop/sim/zephyr/soc/snps/nsim/arc_v/Kconfig"
osource "/home/davit/Desktop/sim/zephyr/soc/snps/nsim/arc_classic/Kconfig"
osource "/home/davit/Desktop/sim/zephyr/soc/snps/hsdk4xd/Kconfig"
osource "/home/davit/Desktop/sim/zephyr/soc/snps/hsdk/Kconfig"
osource "/home/davit/Desktop/sim/zephyr/soc/snps/emsk/Kconfig"
osource "/home/davit/Desktop/sim/zephyr/soc/snps/emsdp/Kconfig"
osource "/home/davit/Desktop/sim/zephyr/soc/snps/arc_iot/Kconfig"
osource "/home/davit/Desktop/sim/zephyr/soc/silabs/Kconfig"
osource "/home/davit/Desktop/sim/zephyr/soc/sifive/sifive_freedom/Kconfig"
osource "/home/davit/Desktop/sim/zephyr/soc/rockchip/Kconfig"
osource "/home/davit/Desktop/sim/zephyr/soc/renode/riscv_virtual/Kconfig"
osource "/home/davit/Desktop/sim/zephyr/soc/renesas/smartbond/Kconfig"
osource "/home/davit/Desktop/sim/zephyr/soc/renesas/rzt2m/Kconfig"
osource "/home/davit/Desktop/sim/zephyr/soc/renesas/rcar/Kconfig"
osource "/home/davit/Desktop/sim/zephyr/soc/renesas/ra/Kconfig"
osource "/home/davit/Desktop/sim/zephyr/soc/raspberrypi/Kconfig"
osource "/home/davit/Desktop/sim/zephyr/soc/quicklogic/eos_s3/Kconfig"
osource "/home/davit/Desktop/sim/zephyr/soc/qemu/virt_riscv/Kconfig"
osource "/home/davit/Desktop/sim/zephyr/soc/qemu/malta/Kconfig"
osource "/home/davit/Desktop/sim/zephyr/soc/openisa/rv32m1/Kconfig"
osource "/home/davit/Desktop/sim/zephyr/soc/nxp/s32/Kconfig"
osource "/home/davit/Desktop/sim/zephyr/soc/nxp/rw/Kconfig"
osource "/home/davit/Desktop/sim/zephyr/soc/nxp/mcx/Kconfig"
osource "/home/davit/Desktop/sim/zephyr/soc/nxp/lpc/Kconfig"
osource "/home/davit/Desktop/sim/zephyr/soc/nxp/layerscape/Kconfig"
osource "/home/davit/Desktop/sim/zephyr/soc/nxp/kinetis/Kconfig"
osource "/home/davit/Desktop/sim/zephyr/soc/nxp/imxrt/Kconfig"
osource "/home/davit/Desktop/sim/zephyr/soc/nxp/imx/Kconfig"
osource "/home/davit/Desktop/sim/zephyr/soc/nuvoton/numicro/Kconfig"
osource "/home/davit/Desktop/sim/zephyr/soc/nuvoton/numaker/Kconfig"
osource "/home/davit/Desktop/sim/zephyr/soc/nuvoton/npcx/Kconfig"
osource "/home/davit/Desktop/sim/zephyr/soc/nuvoton/npcm/Kconfig"
osource "/home/davit/Desktop/sim/zephyr/soc/nordic/Kconfig"
osource "/home/davit/Desktop/sim/zephyr/soc/neorv32/Kconfig"
osource "/home/davit/Desktop/sim/zephyr/soc/native/inf_clock/Kconfig"
osource "/home/davit/Desktop/sim/zephyr/soc/microchip/miv/Kconfig"
osource "/home/davit/Desktop/sim/zephyr/soc/microchip/mec/Kconfig"
osource "/home/davit/Desktop/sim/zephyr/soc/mediatek/mtk_adsp/Kconfig"
osource "/home/davit/Desktop/sim/zephyr/soc/lowrisc/opentitan/Kconfig"
osource "/home/davit/Desktop/sim/zephyr/soc/litex/litex_vexriscv/Kconfig"
osource "/home/davit/Desktop/sim/zephyr/soc/ite/ec/Kconfig"
osource "/home/davit/Desktop/sim/zephyr/soc/intel/raptor_lake/Kconfig"
osource "/home/davit/Desktop/sim/zephyr/soc/intel/lakemont/Kconfig"
osource "/home/davit/Desktop/sim/zephyr/soc/intel/intel_socfpga_std/Kconfig"
osource "/home/davit/Desktop/sim/zephyr/soc/intel/intel_socfpga/Kconfig"
osource "/home/davit/Desktop/sim/zephyr/soc/intel/intel_niosv/Kconfig"
osource "/home/davit/Desktop/sim/zephyr/soc/intel/intel_ish/Kconfig"
osource "/home/davit/Desktop/sim/zephyr/soc/intel/intel_adsp/Kconfig"
osource "/home/davit/Desktop/sim/zephyr/soc/intel/elkhart_lake/Kconfig"
osource "/home/davit/Desktop/sim/zephyr/soc/intel/atom/Kconfig"
osource "/home/davit/Desktop/sim/zephyr/soc/intel/apollo_lake/Kconfig"
osource "/home/davit/Desktop/sim/zephyr/soc/intel/alder_lake/Kconfig"
osource "/home/davit/Desktop/sim/zephyr/soc/infineon/cat3/Kconfig"
osource "/home/davit/Desktop/sim/zephyr/soc/infineon/cat1b/Kconfig"
osource "/home/davit/Desktop/sim/zephyr/soc/infineon/cat1a/Kconfig"
osource "/home/davit/Desktop/sim/zephyr/soc/gd/gd32/Kconfig"
osource "/home/davit/Desktop/sim/zephyr/soc/gaisler/leon3/Kconfig"
osource "/home/davit/Desktop/sim/zephyr/soc/gaisler/gr716a/Kconfig"
osource "/home/davit/Desktop/sim/zephyr/soc/espressif/Kconfig"
osource "/home/davit/Desktop/sim/zephyr/soc/ene/kb1200/Kconfig"
osource "/home/davit/Desktop/sim/zephyr/soc/efinix/sapphire/Kconfig"
osource "/home/davit/Desktop/sim/zephyr/soc/cdns/xtensa_sample_controller/Kconfig"
osource "/home/davit/Desktop/sim/zephyr/soc/cdns/dc233c/Kconfig"
osource "/home/davit/Desktop/sim/zephyr/soc/brcm/bcmvk/Kconfig"
osource "/home/davit/Desktop/sim/zephyr/soc/brcm/bcm2712/Kconfig"
osource "/home/davit/Desktop/sim/zephyr/soc/brcm/bcm2711/Kconfig"
osource "/home/davit/Desktop/sim/zephyr/soc/atmel/sam0/Kconfig"
osource "/home/davit/Desktop/sim/zephyr/soc/atmel/sam/Kconfig"
osource "/home/davit/Desktop/sim/zephyr/soc/aspeed/Kconfig"
osource "/home/davit/Desktop/sim/zephyr/soc/arm/Kconfig"
osource "/home/davit/Desktop/sim/zephyr/soc/arm/beetle/Kconfig"
osource "/home/davit/Desktop/sim/zephyr/soc/andestech/Kconfig"
osource "/home/davit/Desktop/sim/zephyr/soc/ambiq/Kconfig"
osource "/home/davit/Desktop/sim/zephyr/soc/altr/zephyr_nios2f/Kconfig"
osource "/home/davit/Desktop/sim/zephyr/soc/altr/qemu_nios2/Kconfig"
osource "/home/davit/Desktop/sim/zephyr/soc/adi/max32/Kconfig"
```

## sim/build_sim/Kconfig/soc/Kconfig.defconfig
```kconfig
# Load Zephyr SoC Kconfig defconfig.
osource "/home/davit/Desktop/sim/zephyr/soc/xlnx/zynqmp/Kconfig.defconfig"
osource "/home/davit/Desktop/sim/zephyr/soc/xlnx/zynq7000/Kconfig.defconfig"
osource "/home/davit/Desktop/sim/zephyr/soc/xen/Kconfig.defconfig"
osource "/home/davit/Desktop/sim/zephyr/soc/wch/ch32v/Kconfig.defconfig"
osource "/home/davit/Desktop/sim/zephyr/soc/ti/simplelink/Kconfig.defconfig"
osource "/home/davit/Desktop/sim/zephyr/soc/ti/lm3s6965/Kconfig.defconfig"
osource "/home/davit/Desktop/sim/zephyr/soc/ti/k3/Kconfig.defconfig"
osource "/home/davit/Desktop/sim/zephyr/soc/telink/tlsr/Kconfig.defconfig"
osource "/home/davit/Desktop/sim/zephyr/soc/starfive/jh71xx/Kconfig.defconfig"
osource "/home/davit/Desktop/sim/zephyr/soc/st/stm32/Kconfig.defconfig"
osource "/home/davit/Desktop/sim/zephyr/soc/snps/qemu_arc/Kconfig.defconfig"
osource "/home/davit/Desktop/sim/zephyr/soc/snps/nsim/arc_v/Kconfig.defconfig"
osource "/home/davit/Desktop/sim/zephyr/soc/snps/nsim/arc_classic/Kconfig.defconfig"
osource "/home/davit/Desktop/sim/zephyr/soc/snps/hsdk4xd/Kconfig.defconfig"
osource "/home/davit/Desktop/sim/zephyr/soc/snps/hsdk/Kconfig.defconfig"
osource "/home/davit/Desktop/sim/zephyr/soc/snps/emsk/Kconfig.defconfig"
osource "/home/davit/Desktop/sim/zephyr/soc/snps/emsdp/Kconfig.defconfig"
osource "/home/davit/Desktop/sim/zephyr/soc/snps/arc_iot/Kconfig.defconfig"
osource "/home/davit/Desktop/sim/zephyr/soc/silabs/Kconfig.defconfig"
osource "/home/davit/Desktop/sim/zephyr/soc/sifive/sifive_freedom/Kconfig.defconfig"
osource "/home/davit/Desktop/sim/zephyr/soc/rockchip/Kconfig.defconfig"
osource "/home/davit/Desktop/sim/zephyr/soc/renode/riscv_virtual/Kconfig.defconfig"
osource "/home/davit/Desktop/sim/zephyr/soc/renesas/smartbond/Kconfig.defconfig"
osource "/home/davit/Desktop/sim/zephyr/soc/renesas/rzt2m/Kconfig.defconfig"
osource "/home/davit/Desktop/sim/zephyr/soc/renesas/rcar/Kconfig.defconfig"
osource "/home/davit/Desktop/sim/zephyr/soc/renesas/ra/Kconfig.defconfig"
osource "/home/davit/Desktop/sim/zephyr/soc/raspberrypi/Kconfig.defconfig"
osource "/home/davit/Desktop/sim/zephyr/soc/quicklogic/eos_s3/Kconfig.defconfig"
osource "/home/davit/Desktop/sim/zephyr/soc/qemu/virt_riscv/Kconfig.defconfig"
osource "/home/davit/Desktop/sim/zephyr/soc/qemu/malta/Kconfig.defconfig"
osource "/home/davit/Desktop/sim/zephyr/soc/openisa/rv32m1/Kconfig.defconfig"
osource "/home/davit/Desktop/sim/zephyr/soc/nxp/s32/Kconfig.defconfig"
osource "/home/davit/Desktop/sim/zephyr/soc/nxp/rw/Kconfig.defconfig"
osource "/home/davit/Desktop/sim/zephyr/soc/nxp/mcx/Kconfig.defconfig"
osource "/home/davit/Desktop/sim/zephyr/soc/nxp/lpc/Kconfig.defconfig"
osource "/home/davit/Desktop/sim/zephyr/soc/nxp/layerscape/Kconfig.defconfig"
osource "/home/davit/Desktop/sim/zephyr/soc/nxp/kinetis/Kconfig.defconfig"
osource "/home/davit/Desktop/sim/zephyr/soc/nxp/imxrt/Kconfig.defconfig"
osource "/home/davit/Desktop/sim/zephyr/soc/nxp/imx/Kconfig.defconfig"
osource "/home/davit/Desktop/sim/zephyr/soc/nuvoton/numicro/Kconfig.defconfig"
osource "/home/davit/Desktop/sim/zephyr/soc/nuvoton/numaker/Kconfig.defconfig"
osource "/home/davit/Desktop/sim/zephyr/soc/nuvoton/npcx/Kconfig.defconfig"
osource "/home/davit/Desktop/sim/zephyr/soc/nuvoton/npcm/Kconfig.defconfig"
osource "/home/davit/Desktop/sim/zephyr/soc/nordic/Kconfig.defconfig"
osource "/home/davit/Desktop/sim/zephyr/soc/neorv32/Kconfig.defconfig"
osource "/home/davit/Desktop/sim/zephyr/soc/native/inf_clock/Kconfig.defconfig"
osource "/home/davit/Desktop/sim/zephyr/soc/microchip/miv/Kconfig.defconfig"
osource "/home/davit/Desktop/sim/zephyr/soc/microchip/mec/Kconfig.defconfig"
osource "/home/davit/Desktop/sim/zephyr/soc/mediatek/mtk_adsp/Kconfig.defconfig"
osource "/home/davit/Desktop/sim/zephyr/soc/lowrisc/opentitan/Kconfig.defconfig"
osource "/home/davit/Desktop/sim/zephyr/soc/litex/litex_vexriscv/Kconfig.defconfig"
osource "/home/davit/Desktop/sim/zephyr/soc/ite/ec/Kconfig.defconfig"
osource "/home/davit/Desktop/sim/zephyr/soc/intel/raptor_lake/Kconfig.defconfig"
osource "/home/davit/Desktop/sim/zephyr/soc/intel/lakemont/Kconfig.defconfig"
osource "/home/davit/Desktop/sim/zephyr/soc/intel/intel_socfpga_std/Kconfig.defconfig"
osource "/home/davit/Desktop/sim/zephyr/soc/intel/intel_socfpga/Kconfig.defconfig"
osource "/home/davit/Desktop/sim/zephyr/soc/intel/intel_niosv/Kconfig.defconfig"
osource "/home/davit/Desktop/sim/zephyr/soc/intel/intel_ish/Kconfig.defconfig"
osource "/home/davit/Desktop/sim/zephyr/soc/intel/intel_adsp/Kconfig.defconfig"
osource "/home/davit/Desktop/sim/zephyr/soc/intel/elkhart_lake/Kconfig.defconfig"
osource "/home/davit/Desktop/sim/zephyr/soc/intel/atom/Kconfig.defconfig"
osource "/home/davit/Desktop/sim/zephyr/soc/intel/apollo_lake/Kconfig.defconfig"
osource "/home/davit/Desktop/sim/zephyr/soc/intel/alder_lake/Kconfig.defconfig"
osource "/home/davit/Desktop/sim/zephyr/soc/infineon/cat3/Kconfig.defconfig"
osource "/home/davit/Desktop/sim/zephyr/soc/infineon/cat1b/Kconfig.defconfig"
osource "/home/davit/Desktop/sim/zephyr/soc/infineon/cat1a/Kconfig.defconfig"
osource "/home/davit/Desktop/sim/zephyr/soc/gd/gd32/Kconfig.defconfig"
osource "/home/davit/Desktop/sim/zephyr/soc/gaisler/leon3/Kconfig.defconfig"
osource "/home/davit/Desktop/sim/zephyr/soc/gaisler/gr716a/Kconfig.defconfig"
osource "/home/davit/Desktop/sim/zephyr/soc/espressif/Kconfig.defconfig"
osource "/home/davit/Desktop/sim/zephyr/soc/ene/kb1200/Kconfig.defconfig"
osource "/home/davit/Desktop/sim/zephyr/soc/efinix/sapphire/Kconfig.defconfig"
osource "/home/davit/Desktop/sim/zephyr/soc/cdns/xtensa_sample_controller/Kconfig.defconfig"
osource "/home/davit/Desktop/sim/zephyr/soc/cdns/dc233c/Kconfig.defconfig"
osource "/home/davit/Desktop/sim/zephyr/soc/brcm/bcmvk/Kconfig.defconfig"
osource "/home/davit/Desktop/sim/zephyr/soc/brcm/bcm2712/Kconfig.defconfig"
osource "/home/davit/Desktop/sim/zephyr/soc/brcm/bcm2711/Kconfig.defconfig"
osource "/home/davit/Desktop/sim/zephyr/soc/atmel/sam0/Kconfig.defconfig"
osource "/home/davit/Desktop/sim/zephyr/soc/atmel/sam/Kconfig.defconfig"
osource "/home/davit/Desktop/sim/zephyr/soc/aspeed/Kconfig.defconfig"
osource "/home/davit/Desktop/sim/zephyr/soc/arm/Kconfig.defconfig"
osource "/home/davit/Desktop/sim/zephyr/soc/arm/beetle/Kconfig.defconfig"
osource "/home/davit/Desktop/sim/zephyr/soc/andestech/Kconfig.defconfig"
osource "/home/davit/Desktop/sim/zephyr/soc/ambiq/Kconfig.defconfig"
osource "/home/davit/Desktop/sim/zephyr/soc/altr/zephyr_nios2f/Kconfig.defconfig"
osource "/home/davit/Desktop/sim/zephyr/soc/altr/qemu_nios2/Kconfig.defconfig"
osource "/home/davit/Desktop/sim/zephyr/soc/adi/max32/Kconfig.defconfig"
```
